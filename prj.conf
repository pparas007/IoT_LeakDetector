## prj.conf
```kconfig
# From original version of force sensor
CONFIG_ADC=y
CONFIG_ADC_NRFX_SAADC=y
CONFIG_ADC_ASYNC=y
CONFIG_ADC_0=y
CONFIG_ADC_LOG_LEVEL_INF=y
CONFIG_LOG=y

# Enabling Bluetooth
CONFIG_BT=y

# Need to be removed after deployment
#CONFIG_NO_OPTIMIZATIONS=y

# Enable for connection to my ThingsBoard, disable for connection to Jinchi's ThingsBoard
# Include the following if communicating with a Linux kernel version < 4.12
# When the line is disabled the MAC assigned to the board E8:73:30:1B:80:51
# When the line is enabled the MAC assigned to the board EA:73:30:1B:80:51
#CONFIG_NET_L2_BT_ZEP1656=y
CONFIG_INIT_STACKS=y
CONFIG_GPIO=y
CONFIG_SERIAL=n
CONFIG_PRINTK=y
CONFIG_USE_SEGGER_RTT=y
CONFIG_RTT_CONSOLE=y
CONFIG_LOG_BACKEND_RTT_MODE_DROP=y

CONFIG_NETWORKING=y

CONFIG_NET_L2_BT=y
CONFIG_NET_L2_BT_SEC_LEVEL=1

CONFIG_NET_IPV4=n
CONFIG_NET_IPV6=y
CONFIG_NET_TCP=y
CONFIG_NET_UDP=y
CONFIG_NET_ARP=y
CONFIG_NET_IPV6_RA_RDNSS=y
CONFIG_NET_IPV6_MAX_NEIGHBORS=6
CONFIG_NET_MAX_CONTEXTS=5
CONFIG_NET_LOG=y
CONFIG_NET_SHELL=y

CONFIG_NET_PKT_RX_COUNT=16
CONFIG_NET_PKT_TX_COUNT=16

CONFIG_NET_BUF_DATA_SIZE=256
CONFIG_NET_BUF_RX_COUNT=15
CONFIG_NET_BUF_TX_COUNT=15

CONFIG_NET_IF_UNICAST_IPV6_ADDR_COUNT=3
CONFIG_NET_IF_MCAST_IPV6_ADDR_COUNT=5

CONFIG_NET_CONFIG_SETTINGS=y
#CONFIG_NET_CONFIG_PEER_IPV6_ADDR="fe80::1a:7dff:feda:7111"
# My DELL laptop's ip with ThingsBoard
# CONFIG_NET_CONFIG_PEER_IPV6_ADDR="fe80::c68e:8fff:fef8:f65e"
# My DELL laptop's ip with ThingsBoard via dongle
#CONFIG_NET_CONFIG_PEER_IPV6_ADDR="fe80::a00:27ff:feaf:1d83"
# Jinxi's laptop ip with ThingsBoard
CONFIG_NET_CONFIG_PEER_IPV6_ADDR="fe80::f894:c2ff:febf:9e96"
# Jinxi's laptop ip with ThingsBoard via dongle
# CONFIG_NET_CONFIG_PEER_IPV6_ADDR="fe80::1a:7dff:feda:7113"
CONFIG_NET_CONFIG_BT_NODE=y

CONFIG_MQTT_LIB=y
CONFIG_JSON_LIBRARY=y

CONFIG_MAIN_STACK_SIZE=2048

CONFIG_ENTROPY_GENERATOR=y
CONFIG_TEST_RANDOM_GENERATOR=y
CONFIG_TIMER_RANDOM_GENERATOR=y

CONFIG_BT_SIGNING=y
CONFIG_BT_RX_STACK_SIZE=1024
CONFIG_BT_DEVICE_NAME="TEAM04-BOARD"
# App may not fit in RAM with ECC enabled
CONFIG_BT_TINYCRYPT_ECC=n
CONFIG_BT_L2CAP_TX_BUF_COUNT=3
CONFIG_BT_L2CAP_TX_MTU=65
CONFIG_BT_L2CAP_DYNAMIC_CHANNEL=y
CONFIG_BT_HCI_TX_STACK_SIZE=640
CONFIG_BT_HCI_HOST=y
CONFIG_BT_HCI_CMD_COUNT=2
CONFIG_BT_RX_BUF_COUNT=20
# Test lower value to save RAM (orig 1024)
CONFIG_BT_RX_BUF_LEN=512
CONFIG_BT_RECV_IS_RX_THREAD=y
CONFIG_BT_DEBUG_LOG=y
```

## src/main.c
```c
/*
 * Copyright (c) 2017 Intel Corporation
 *
 * SPDX-License-Identifier: Apache-2.0
 */

 #define LOG_MODULE_NAME net_tb_device
 #define NET_LOG_LEVEL LOG_LEVEL_DBG

#include <zephyr.h>

#include <net/net_context.h>

#include <misc/printk.h>
#include <string.h>
#include <stdio.h>
#include <errno.h>

#if defined(CONFIG_NET_L2_BT)
#include <bluetooth/bluetooth.h>
#include <bluetooth/conn.h>
#endif

#include "tb_pubsub.h"
#include "lights.h"
#include "sensors.h"
#include "config.h"

#define ATTR_UPDATE_INTERVAL 15000

#define RC_STR(rc)  ((rc) == 0 ? "OK" : "ERROR")
#define PRINT_RESULT(func, rc)  \
  printf("[%s:%d] %s: %d <%s>\n", __func__, __LINE__, \
         (func), rc, RC_STR(rc))

static void update_attributes()
{
  static char payload[128];

  //TODO: Need to refactor to centralize
  /* Formulate the JSON payload for the attribute update */
  //Send basic info
  snprintf(payload, sizeof(payload), "{\"firmware_version\":\"%s\", \"serial_number\":\"%s\", \"uptime\":\"%d\"}",
    "1.0.0",
    "TEAM-IOT-4",
    (uint32_t)k_uptime_get_32() / 1000);
  tb_publish_attributes(payload);

  //TODO: one method to send attributes
}

#if defined(CONFIG_NET_L2_BT)
static bool bt_connected;

static
void bt_connect_cb(struct bt_conn *conn, u8_t err)
{
  bt_connected = true;
}

static
void bt_disconnect_cb(struct bt_conn *conn, u8_t reason)
{
  bt_connected = false;
  printf("bt disconnected (reason %u)\n", reason);
}

static
struct bt_conn_cb bt_conn_cb = {
  .connected = bt_connect_cb,
  .disconnected = bt_disconnect_cb,
};
#endif

static int network_setup(void)
{

#if defined(CONFIG_NET_L2_BT)
  const char *progress_mark = "/-\\|";
  int i = 0;
  int rc;

  rc = bt_enable(NULL);
  if (rc && rc != -EALREADY) {
    printf("bluetooth init failed\n");
    return rc;
  }

  bt_conn_cb_register(&bt_conn_cb);

  printf("\nwaiting for bt connection: ");
  while (bt_connected == false) {
    k_sleep(250);
    printf("%c\b", progress_mark[i]);
    i = (i + 1) % (sizeof(progress_mark) - 1);
  }
  printf("\n");
#endif

  return 0;
}

void main(void)
{
  int rc;

  rc = network_setup();
  PRINT_RESULT("network_setup", rc);
  if (rc < 0) {
    return;
  }
  
  lights_init();
  tb_pubsub_start();
  
  k_sleep(ATTR_UPDATE_INTERVAL);
  update_attributes();
  sensors_start();
  
  /*
  while (true) {
    k_sleep(ATTR_UPDATE_INTERVAL);
    update_attributes();
  }
  */
}
```

## src/config.h
```c
/*
 * Copyright (c) 2017 Intel Corporation
 *
 * SPDX-License-Identifier: Apache-2.0
 */

#ifndef __CONFIG_H__
#define __CONFIG_H__

#ifdef CONFIG_NET_CONFIG_SETTINGS
#ifdef CONFIG_NET_IPV6
#define ZEPHYR_ADDR		CONFIG_NET_CONFIG_MY_IPV6_ADDR
#define SERVER_ADDR		CONFIG_NET_CONFIG_PEER_IPV6_ADDR
#else
#define ZEPHYR_ADDR		CONFIG_NET_CONFIG_MY_IPV4_ADDR
#define SERVER_ADDR		CONFIG_NET_CONFIG_PEER_IPV4_ADDR
#endif
#else
#ifdef CONFIG_NET_IPV6
#define ZEPHYR_ADDR		"2001:db8::1"
#define SERVER_ADDR		"2001:db8::2"
#else
#define ZEPHYR_ADDR		"192.168.1.101"
#define SERVER_ADDR		"192.168.1.10"
#endif
#endif

#define MQTT_CLIENTID		"zephyr_publisher"

#ifdef CONFIG_MQTT_LIB_TLS
#define SERVER_PORT		8883
#else
#define SERVER_PORT		1883
#endif

#define APP_NET_INIT_TIMEOUT    15000
//from Mengxuan
//#define APP_NET_INIT_TIMEOUT    30000
#define APP_TX_RX_TIMEOUT       1000
//from Mengxuan
//#define APP_TX_RX_TIMEOUT       5000
#define APP_CONN_TRIES          10
#define APP_TX_CONN_TRIES       APP_CONN_TRIES
#define APP_TX_CONN_TIMEOUT     20000

#endif
```

## src/force_sensor.c
```c
#include <zephyr.h>
#include <board.h>
#include <device.h>
#include <adc.h>
#include <kernel.h>
#include <hal/nrf_saadc.h>
#include <misc/printk.h>
#include "config.h"
#include "tb_pubsub.h"
#include "lights.h"

//http://infocenter.nordicsemi.com/pdf/nRF52840_PS_v1.0.pdf
//pg 349
#define ADC_DEVICE_NAME   CONFIG_ADC_0_NAME
#define ADC_RESOLUTION    10
#define ADC_GAIN    ADC_GAIN_1_6 //1/6
#define ADC_REFERENCE   ADC_REF_INTERNAL //0.6
#define ADC_ACQUISITION_TIME  ADC_ACQ_TIME(ADC_ACQ_TIME_MICROSECONDS, 10)
#define ADC_1ST_CHANNEL_ID  0
#define ADC_1ST_CHANNEL_INPUT NRF_SAADC_INPUT_AIN1
#define ADC_2ND_CHANNEL_ID  2
#define ADC_2ND_CHANNEL_INPUT NRF_SAADC_INPUT_AIN2

#define BUFFER_SIZE  6
static s16_t m_sample_buffer[BUFFER_SIZE];

static const struct adc_channel_cfg m_1st_channel_cfg = {
  .gain             = ADC_GAIN,
  .reference        = ADC_REFERENCE,
  .acquisition_time = ADC_ACQUISITION_TIME,
  .channel_id       = ADC_1ST_CHANNEL_ID,
#if defined(CONFIG_ADC_CONFIGURABLE_INPUTS)
  .input_positive   = ADC_1ST_CHANNEL_INPUT,
#endif
};

#if defined(ADC_2ND_CHANNEL_ID)
static const struct adc_channel_cfg m_2nd_channel_cfg = {
  .gain             = ADC_GAIN,
  .reference        = ADC_REFERENCE,
  .acquisition_time = ADC_ACQUISITION_TIME,
  .channel_id       = ADC_2ND_CHANNEL_ID,
#if defined(CONFIG_ADC_CONFIGURABLE_INPUTS)
  .input_positive   = ADC_2ND_CHANNEL_INPUT,
#endif
};
#endif /* defined(ADC_2ND_CHANNEL_ID) */

//method to init ADC interface
static struct device *init_adc(void)
{
  int ret;
  struct device *adc_dev = device_get_binding(ADC_DEVICE_NAME);

  if (!adc_dev) {
    printk("Cannot get ADC device");
    return;
  }

  ret = adc_channel_setup(adc_dev, &m_1st_channel_cfg);
  if (ret) {
    printk("Setting up of the first channel failed with code %d", ret);
  }

#if defined(ADC_2ND_CHANNEL_ID)
  ret = adc_channel_setup(adc_dev, &m_2nd_channel_cfg);
  if (ret) {
    printk("Setting up of the second channel failed with code %d", ret);
  }
#endif /* defined(ADC_2ND_CHANNEL_ID) */

  (void)memset(m_sample_buffer, 0, sizeof(m_sample_buffer));

  return adc_dev;
}

//method to sample sensor, which in turns calls init_adc
int sample_sensor (int channel_id)
{
  int ret;

  const struct adc_sequence sequence = {
    .channels    = BIT(channel_id),
    .buffer      = m_sample_buffer,
    .buffer_size = sizeof(m_sample_buffer),
    .resolution  = ADC_RESOLUTION,
  };

  struct device *adc_dev = init_adc();

  if (!adc_dev) {
    printk("Failed to initialise ADC");
    return -1;
  }

  ret = adc_read(adc_dev, &sequence);

  if (ret) {
    printk("Failed to read ADC with code %d", ret);
  }

  return m_sample_buffer[0];
}

u32_t state[4];
int current_value;
u8_t current_level;
// Non use constant
u8_t previous_reported_level = 4;
char *current_level_label;

int SAMPLE_LOW_LEVEL = 10;
int SAMPLE_MID_LEVEL = 250;
int SAMPLE_HIGH_LEVEL = 500;

#define SAMPLE_NONE_LEVEL_LABEL  "NONE"
#define SAMPLE_LOW_LEVEL_LABEL  "LOW"
#define SAMPLE_MID_LEVEL_LABEL  "MID"
#define SAMPLE_HIGH_LEVEL_LABEL  "HIGH"

#define SLIDING_WINDOW_SIZE  3


// Low is represented by 1
// Mid is be represented by 2
// High is be represented by 3
u8_t previous_samples_levels[SLIDING_WINDOW_SIZE];


//TODO: Don't think the next line is necessary
//TODO: Correct, following line is unnecessary if code reorganized
//int btn_alert_handler2(struct k_alert *alert);
//renaming force_pub_alert_handler because it is being repeated across other c files

int force_pub_alert_handler(struct k_alert *alert)
{
	int value;
	//char payload[16];
  char payload[32];

  /* Context: Zephy kernel workqueue thread */

	printf("Force sensor sensing event!\n");

  /* Iterate over each button looking for a change from the previously
    * published state */
  //Skipping that for now, see below for example of comparing states for the button
  //for (u32_t i = 0; i < BTN_COUNT; i++) {
  //gpio_pin_read(btn_dev, btn_arr[i], &value);
  //if (value != state[i]) {
    //TODO: hardcoding values
    u32_t i = 1;
    value = 1;
    /* Formulate JSON in the format expected by thingsboard.io */
    //TODO: Uncomment after initial button telemetry test
    //u32_t i;
		//int value;
	  //snprintf(payload, sizeof(payload), "{\"btn%d\":%s}", i, value ? "false" : "true");
    //snprintf(payload, sizeof(payload), "{\"frc\":\"%s\"}", current_level_label);
    snprintf(payload, sizeof(payload), "{\"frc\":\"%s\", \"frcLvl\":%d}", current_level_label, current_level);
    //snprintf(payload, sizeof(payload), "{\"frcVal\":%d}", current_value);
    //snprintf(payload, sizeof(payload), "{\"firmware_version\":\"%s\", \"serial_number\":\"%s\", \"uptime\":\"%d\"}",
    //"1.2.3",
    //"jdukes-001",
    //(uint32_t)k_uptime_get_32() / 1000);
    previous_reported_level = current_level;
    tb_publish_telemetry(payload);
    //TODO: If it is a different state, then change
    //state[i] = value;
  //}
  //}
	return 0;
}

//K_ALERT_DEFINE(name, handler, max_num_pending_alerts)
K_ALERT_DEFINE(force_pub_alert, force_pub_alert_handler, 10);

void update_sample_history() {
  // Updating sliding window
  for (int i = SLIDING_WINDOW_SIZE - 1; i >= 0; i--) {
    previous_samples_levels[i] = previous_samples_levels[i - 1];
  }
  previous_samples_levels[0] = current_level;
  printf("previous force samples!\n");
  printf("[%d], [%d], [%d]\n", previous_samples_levels[0], previous_samples_levels[1], previous_samples_levels[2]);
}

void check_and_report() {
  update_sample_history();

  bool repetition = true;
  // Checking the last samples
  for (int i = 1; i < SLIDING_WINDOW_SIZE; i++) {
    repetition = repetition && (previous_samples_levels[i - 1] == previous_samples_levels[i]);
  }
  printf("repetition [%d] \n", repetition);

  //If NONE turn off light
  if (current_level == 0){
    putLights(LED_FRC, false);
  }//OTHERWISE, turn on light
  else {
    putLights(LED_FRC, true);
  }

  // Report if there is a stable level and it is different than the one reported before
  if (repetition && current_level != previous_reported_level) {
    //TODO: Review the purpose of the alert
    printf("Signalling alert!\n");
    k_alert_send(&force_pub_alert);
  }
}

//
void tic_force_sensor_handler(struct k_work *work)
{
  int sample;
  int fsrVoltage;
  unsigned long fsrResistance;  // The voltage converted to resistance, can be very big so make "long"
  unsigned long fsrConductance; 
  long fsrForce;       // Finally, the resistance converted to force
  
  printk("\nSampling ... ");

  sample = sample_sensor(ADC_1ST_CHANNEL_ID);
  current_value = sample;
  printk("%d \n", sample);

  // analog voltage reading ranges from about 2 to 783 which maps to 0V to 3.3V (= 3300mV)
  //fsrVoltage = map(fsrReading, 1, 783, 0, 3300);
  //double fsrVoltage = ((sample - 1) / ((double) (783 - 1))) * 3300;
  //fsrVoltage = 3300 / (1023);
  //fsrVoltage = 3300 / (796);
  //fsrVoltage = fsrVoltage * (sample - 1);
  fsrVoltage = 3300 * (sample - 1) / 800;

  //double fsrVoltage = ((sample - 1) / ((double) (783 - 1))) * 3300;
  //printk("%f \n", fsrVoltage);
  printk("Voltage reading in mV = %d \n", fsrVoltage);

  // The voltage = Vcc * R / (R + FSR) where R = 4.7K and Vcc = 3.3V
  // so FSR = ((Vcc - V) * R) / V        yay math!
  fsrResistance = 3300 - fsrVoltage;     // fsrVoltage is in millivolts so 3.3V = 3300mV
  fsrResistance *= 4700;                // 4.7K resistor
  fsrResistance /= fsrVoltage;
  printk("FSR resistance in ohms = %ld \n", fsrResistance);

  fsrConductance = 1000000;           // we measure in micromhos so 
  fsrConductance /= fsrResistance;
  printk("Conductance in microMhos: %ld \n", fsrConductance);

  /*
  // Use the two FSR guide graphs to approximate the force
  if (fsrConductance <= 1000) {
    fsrForce = fsrConductance / 80;
    Serial.print("Force in Newtons: ");
    Serial.println(fsrForce);      
  } else {
    fsrForce = fsrConductance - 1000;
    fsrForce /= 30;
    Serial.print("Force in Newtons: ");
    Serial.println(fsrForce);            
  }*/

  /* Context: worker handler */
  printf("sample: %d\n", sample);

  if (sample >= SAMPLE_HIGH_LEVEL) {
    current_level = 3;
    current_level_label = SAMPLE_HIGH_LEVEL_LABEL;
  }
  else {
    if (sample >= SAMPLE_MID_LEVEL) {
      current_level = 2;
      current_level_label = SAMPLE_MID_LEVEL_LABEL;
    }
    else {
      if (sample >= SAMPLE_LOW_LEVEL) {
        current_level = 1;
        current_level_label = SAMPLE_LOW_LEVEL_LABEL;
      }
      else {
        current_level = 0;
        current_level_label = SAMPLE_NONE_LEVEL_LABEL;
      }
    }
  }

  check_and_report();
}

K_WORK_DEFINE(tic_force_sensor, tic_force_sensor_handler);

/*
void my_timer_handler(struct k_timer *dummy)
{
  k_work_submit(&tic_force_sensor);
}

K_TIMER_DEFINE(my_timer, my_timer_handler, NULL);
*/

void init_force_sensor()
{
  printk("Preparing ADC\n");
  /* start periodic timer that expires once every X period seconds */
  //https://docs.zephyrproject.org/1.9.0/kernel/timing/timers.html
  
  //Moving timer to sensors
  //k_timer_start(name, duration, period)
  //k_timer_start(&my_timer, K_SECONDS(1), K_SECONDS(5));
  //k_timer_stop(&my_timer);
}
```

## src/force_sensor.h
```c
#ifndef __FORCE_SENSOR_H__
#define __FORCE_SENSOR_H__

struct k_work tic_force_sensor;
void init_force_sensor();

#endif
```

## src/lights.c
```c
#include <zephyr.h>
#include <board.h>
#include <device.h>
#include <gpio.h>
#include "lights.h"
#include <misc/printk.h>

#define LED_PORT LED0_GPIO_CONTROLLER
#define LED_COUNT 4

const u32_t led_arr[LED_COUNT] = {
    LED0_GPIO_PIN,
    LED1_GPIO_PIN,
    LED2_GPIO_PIN,
    LED3_GPIO_PIN
};

struct device *led_dev;

void putLights(u32_t ledno, bool state)
{
    if (state) {
        printf("\n%d means true, sends 0 to gpio_pin_write\n", state);
    }
    else {
        printf("\n%d means false, sends 1 to gpio_pin_write\n", state);
    }
    gpio_pin_write(led_dev, led_arr[ledno], state ? 0 : 1);
}

bool getLights(u32_t ledno)
{
    u32_t value;

    gpio_pin_read(led_dev, led_arr[ledno], &value);

    return value ? false : true;
}

void lights_init()
{
    led_dev = device_get_binding(LED_PORT);
    
    for (u32_t i = 0; i < LED_COUNT; i++) {
        gpio_pin_configure(led_dev, led_arr[i], GPIO_DIR_OUT);
        gpio_pin_write(led_dev, led_arr[i], 1);
    }
}
```

## src/lights.h
```c
#ifndef __LIGHTS_H__
#define __LIGHTS__

#define LED_MQTT 0
#define LED_FRC 1
#define LED_WTR 2
#define LED_VLV 3

void putLights(u32_t ledno, bool state);
bool getLights(u32_t ledno);
void lights_init();

#endif
```

## src/sensors.c
```c
#include <zephyr.h>
#include <board.h>
#include <device.h>
#include <misc/printk.h>
#include <kernel.h>
#include "config.h"
#include "tb_pubsub.h"
#include "force_sensor.h"
#include "water_flow_sensor.h"
#include "valve.h"

void my_timer_handler(struct k_timer *dummy)
{
  k_work_submit(&tic_force_sensor);
  k_work_submit(&tic_water_sensor);
}

K_TIMER_DEFINE(my_timer, my_timer_handler, NULL);

void sensors_start()
{
  printk("External sensors startging\n");
  init_force_sensor();
  init_water_flow_sensor();
  init_valve();
  /* start periodic timer that expires once every X period seconds */
  //https://docs.zephyrproject.org/1.9.0/kernel/timing/timers.html
  
  //k_timer_start(name, duration, period)
  k_timer_start(&my_timer, K_SECONDS(1), K_SECONDS(3));
  //k_timer_stop(&my_timer);
}
```

## src/tb_pubsub.c
```c
/*
 * Copyright (c) 2017 Intel Corporation
 *
 * SPDX-License-Identifier: Apache-2.0
 */

#define LOG_MODULE_NAME net_tb_pubsub
#define NET_LOG_LEVEL LOG_LEVEL_DBG

#include "tb_pubsub.h"

#include <zephyr.h>
#include <net/mqtt.h>

#include <misc/printk.h>
#include <string.h>
#include <stdio.h>
#include <bluetooth/bluetooth.h>

#include <json.h>

#include "lights.h"
#include "valve.h"
//#include "force_sensor.h"
//#include "water_flow_sensor.h"

#include "config.h"

#define MAX_PENDING_PUB_MSGS 8
#define PUBSUB_STACK_SIZE 1024
#define PUBSUB_PRIORITY 5

static const char *TB_ATTRIBUTES_TOPIC = "v1/devices/me/attributes";
static const char *TB_TELEMETRY_TOPIC = "v1/devices/me/telemetry";
static const char *TB_RPC_TOPIC[] = {"v1/devices/me/rpc/request/+"};
static const enum mqtt_qos TB_RPC_QOS[] = {MQTT_QoS0};

/* For some reason thingsboard.io is very slow to respond to TX Connect
 * requests. We'll implement them using an alert to signal when
 * a connection is established. */
K_ALERT_DEFINE(tb_connack_alert, K_ALERT_DEFAULT, 1);

#define RC_STR(rc)	((rc) == 0 ? "OK" : "ERROR")
#define PRINT_RESULT(func, rc)	\
	printf("[%s:%d] %s: %d <%s>\n", __func__, __LINE__, \
	       (func), rc, RC_STR(rc))

/* Container for some structures used by the MQTT pubsub app. */
static struct pubsub_ctx {
	/**
	 * The connect message structure is only used during the connect
	 * stage. Developers must set some msg properties before calling the
	 * mqtt_tx_connect routine. See below.
	 */
	struct mqtt_connect_msg connect_msg;

	/**
	 * This is the MQTT application context variable.
	 */
	struct mqtt_ctx mqtt_ctx;
} pubsub_ctx;

/* MQTT publish message descriptor */
static struct pub_msg {
	struct k_mem_block mem_block;
	struct mqtt_publish_msg mqtt_publish_msg;
};

/* Message Queue and Memory Pool for publish message descriptors and
 * associated JSON payload */
K_MSGQ_DEFINE(msgq, sizeof(struct pub_msg), MAX_PENDING_PUB_MSGS, 4);
K_MEM_POOL_DEFINE(pub_pool, 16, 128, 8, 4);

/* TODO: Replace by custom JSON that Paras' board will receive to activate the valve */
/* Must match the JSON payload format specified by JSON_OBJ_DESCR... below */
struct rpc_putLights {
	const char* method;
	struct rpc_putLights_params {
		int ledno;
		bool value;
	} params;
};

/* TODO: Add custom handlers to change device parameters and other config, e.g., timers, tresholds, etc. */
void handle_putLights(char *json, int json_len)
{
	printf("[%s:%d] parsing: %s\n",	__func__, __LINE__, json);

	/* Refer to zephyr/include/json.h !!! */

	/* JSON RPC params for putLights */
	static const struct json_obj_descr rpc_descr_params[] = {
		JSON_OBJ_DESCR_PRIM(struct rpc_putLights_params, ledno, JSON_TOK_NUMBER),
		JSON_OBJ_DESCR_PRIM(struct rpc_putLights_params, value, JSON_TOK_TRUE),
	};

	/* JSON generic thingsboard.io RPC */
	static const struct json_obj_descr rpc_descr[] = {
		JSON_OBJ_DESCR_PRIM(struct rpc_putLights, method, JSON_TOK_STRING),
		JSON_OBJ_DESCR_OBJECT(struct rpc_putLights, params, rpc_descr_params)
	};

	struct rpc_putLights rx_rpc={};

	json_obj_parse(json, json_len, rpc_descr, ARRAY_SIZE(rpc_descr), &rx_rpc);

	printf("[%s:%d] parsed method: %s, params: led%d=%s\n",
		__func__, __LINE__, rx_rpc.method, rx_rpc.params.ledno, rx_rpc.params.value ? "ON" : "OFF");

	/* Call light control provided by lights.c */
	putLights(rx_rpc.params.ledno, rx_rpc.params.value);
}

void handle_closeValve(char *json, int json_len)
{
    printf("in handle_closeValve");
	closeValve();
}

void handle_openValve(char *json, int json_len)
{
    printf("in handle_closeValve");
	openValve();
}

/*
 * Process an RPC request received from the thingsboard instance
 */
void handle_rpc(char *json, int json_len)
{
	/* Ideally we would parse the JSON fully here extracting both the method
	 * name and the parameters. However, the limited JSON implementation
	 * in Zephyr means that we must know the structure of the entire JSON
	 * payload when it being parsed but we can't know that here until we
	 * know the RPC method name.
	 *
	 * As a work-around, we do a rudimentary string
	 * comparison to look for supported RPC method names (e.g. putLights) and
	 * then pass the JSON on to be fully parsed in a RPC method-specific
	 * function.
	 */

	printf("json:  %s",json);

	//TODO: Replace by custom call to detect message to activate the valve
	if ( strncmp(&json[11], "putLights", strlen("putLights")) == 0 ) {
		handle_putLights(json, json_len);
	}
	else if ( strncmp(&json[11], "closeValve", strlen("closeValve")) == 0 ) {
		handle_closeValve(json, json_len);
	}
    else if ( strncmp(&json[11], "openValve", strlen("openValve")) == 0 ) {
		handle_openValve(json, json_len);
	}
	/*
	else if ( strncmp(&json[11], "putLights", strlen("myMethod")) == 0 ) {
		handle_myMethod(json, json_len);
	}
	*/
	/*
	else if ( strncmp(&json[11], "putLights", strlen("myMethod")) == 0 ) {
		handle_myMethod(json, json_len);
	}
	*/
}

/* The signature of this routine must match the connect callback declared at
 * the mqtt.h header.
 */
static void connect_cb(struct mqtt_ctx *mqtt_ctx)
{
	printf("[%s:%d]\n", __func__, __LINE__);

	k_alert_send(&tb_connack_alert);
}

/* The signature of this routine must match the disconnect callback declared at
 * the mqtt.h header.
 */
static void disconnect_cb(struct mqtt_ctx *mqtt_ctx)
{
	printf("[%s:%d]\n", __func__, __LINE__);

}

/**
 * The signature of this routine must match the publish_tx callback declared at
 * the mqtt.h header.
 *
 * Applications must keep a "message database" with pkt_id's. So far, this is
 * not implemented here. For example, if we receive a PUBREC message with an
 * unknown pkt_id, this routine must return an error, for example -EINVAL or
 * any negative value.
 */
static int publish_tx_cb(struct mqtt_ctx *mqtt_ctx, u16_t pkt_id,
		      enum mqtt_packet type)
{
	const char *str;
	int rc = 0;

	switch (type) {
	case MQTT_PUBACK:
		str = "MQTT_PUBACK";
		break;
	case MQTT_PUBCOMP:
		str = "MQTT_PUBCOMP";
		break;
	case MQTT_PUBREC:
		str = "MQTT_PUBREC";
		break;
	default:
		rc = -EINVAL;
		str = "Invalid MQTT packet";
	}

	printf("[%s:%d] <%s> packet id: %u\n", __func__, __LINE__, str, pkt_id);

	return rc;
}


/**
 * The signature of this routine must match the publish_rx callback declared at
 * the mqtt.h header.
 */
static int publish_rx_cb(struct mqtt_ctx *ctx, struct mqtt_publish_msg *msg,
		  u16_t pkt_id, enum mqtt_packet type)
{
	const char *str;
	int rc = 0;

	/* Received a MQTT message published to a topic to which
	 * we have subscribed. In this case, this will mean an RPC
	 * request originated from our thingsboard instance. */

	switch (type) {
	case MQTT_PUBLISH:
		str = "MQTT_PUBLISH";
		break;
	default:
		rc = -EINVAL;
		str = "Invalid or unsupported MQTT packet";
	}

	msg->msg[msg->msg_len] = 0;

	printf("[%s:%d] <%s> packet id: %u\n    topic: %s\n    payload: %s\n",
		__func__, __LINE__, str, pkt_id, msg->topic, msg->msg);

	/* Pass on for RPC processing */
	handle_rpc(msg->msg, msg->msg_len);

	return rc;
}

static int subscribe_cb(struct mqtt_ctx *ctx, u16_t pkt_id,
		 u8_t items, enum mqtt_qos qos[])
{
	/* Successful subscription to MQTT topic */

	printf("[%s:%d] <%s> packet id: %u\n", __func__, __LINE__, "MQTT_SUBACK", pkt_id);
	return 0;
}


static int unsubscribe_cb(struct mqtt_ctx *ctx, u16_t pkt_id)
{
	printf("[%s:%d] <%s> packet id: %u\n", __func__, __LINE__, "MQTT_UNSUBACK", pkt_id);
	return 0;
}

/**
 * The signature of this routine must match the malformed callback declared at
 * the mqtt.h header.
 */
static void malformed_cb(struct mqtt_ctx *mqtt_ctx, u16_t pkt_type)
{
	printf("[%s:%d] pkt_type: %u\n", __func__, __LINE__, pkt_type);
}

K_THREAD_STACK_DEFINE(pubsub_stack_area, PUBSUB_STACK_SIZE);
struct k_thread pubsub_thread_desc;

/**
 * Thread to manage thingsboard.io communication
 */
void pubsub_thread(void * unused1, void * unused2, void * unused3)
{
	ARG_UNUSED(unused1);
	ARG_UNUSED(unused2);
	ARG_UNUSED(unused3);

	int i, rc;
	char token[BT_ADDR_STR_LEN];
	struct bt_le_oob oob;
	struct pub_msg pub_msg;

	/* Set everything to 0 and later just assign the required fields. */
	memset(&pubsub_ctx, 0x00, sizeof(pubsub_ctx));

	/* connect, disconnect and malformed may be set to NULL */
	pubsub_ctx.mqtt_ctx.connect = connect_cb;

	pubsub_ctx.mqtt_ctx.disconnect = disconnect_cb;
	pubsub_ctx.mqtt_ctx.malformed = malformed_cb;
	pubsub_ctx.mqtt_ctx.publish_tx = publish_tx_cb;
	pubsub_ctx.mqtt_ctx.publish_rx = publish_rx_cb;
	pubsub_ctx.mqtt_ctx.subscribe = subscribe_cb;

	pubsub_ctx.mqtt_ctx.net_init_timeout = APP_NET_INIT_TIMEOUT;
	pubsub_ctx.mqtt_ctx.net_timeout = APP_TX_RX_TIMEOUT;

	pubsub_ctx.mqtt_ctx.peer_addr_str = SERVER_ADDR;
	pubsub_ctx.mqtt_ctx.peer_port = SERVER_PORT;

	/* TODO: Check if this needs to change */
	/* IMPORTANT: Using the Bluetooth address as the thingsboard.io
	 * ACCESS TOKEN. You MUST configure the ACCESS TOKEN in your
	 * thingsboard.io instance. */
	bt_le_oob_get_local(BT_ID_DEFAULT, &oob);
	bt_addr_to_str(&oob.addr.a, token, sizeof(token));
	pubsub_ctx.connect_msg.user_name = token;

	printf("Connecting with thingsboard.io token: %s\n", token);

	pubsub_ctx.connect_msg.user_name_len = strlen(pubsub_ctx.connect_msg.user_name);

	pubsub_ctx.connect_msg.client_id = MQTT_CLIENTID;
	pubsub_ctx.connect_msg.client_id_len = strlen(MQTT_CLIENTID);

	/* Must be 1 - 0 not yet supported by Zephyr */
	pubsub_ctx.connect_msg.clean_session = 1;

	/* We are both a MQTT APP PUBLISHER and a MQTT APP SUBSCRIBER!! */
	rc = mqtt_init(&pubsub_ctx.mqtt_ctx, MQTT_APP_PUBLISHER_SUBSCRIBER);
	PRINT_RESULT("mqtt_init", rc);

	if (rc != 0) {
		goto exit_pub;
	}

	// To allow us to start wireshark!!!
	k_sleep(10000);

	/* Open a TCP connection to the thingsboard.io instance */
	i = 0;
	do {
		k_sleep(APP_TX_RX_TIMEOUT);
		rc = mqtt_connect(&pubsub_ctx.mqtt_ctx);
		PRINT_RESULT("mqtt_connect", rc);
	} while (rc != 0 && i++ < APP_CONN_TRIES);

	if (rc != 0) {
		goto exit_pub;
	}

	//turn on LED1 to indicate connection was successful to TB via TCD (mqtt_connect())
	/* Call light control provided by lights.c */
	//Turning on lights
	putLights(LED_MQTT, true);

	/* Open an MQTT session to the thingsboard.io instance */
	i = 0;
	do {
		rc = mqtt_tx_connect(&pubsub_ctx.mqtt_ctx, &pubsub_ctx.connect_msg);
		PRINT_RESULT("mqtt_tx_connect", rc);
		k_alert_recv(&tb_connack_alert, APP_TX_CONN_TIMEOUT);
	} while (rc == 0 && i++ < APP_TX_CONN_TRIES && !pubsub_ctx.mqtt_ctx.connected);

	if (!pubsub_ctx.mqtt_ctx.connected) {
		mqtt_close(&pubsub_ctx.mqtt_ctx);
		goto exit_pub;
	}

	/* Subscribe to RPC messages (e.g. for LED control). When they arrive, the
	 * RPC requests will appear first in publish_rx_cb(...) and will be passed on
	 * to  handle_rpc(...), which you should customize for your own
	  application requirments. */
	rc = mqtt_tx_subscribe(&pubsub_ctx.mqtt_ctx, sys_rand32_get(), 1,
		TB_RPC_TOPIC, TB_RPC_QOS);

	PRINT_RESULT("mqtt_tx_subscribe", rc);


	/* From here we enter an infinite loop, blocking until we receive a
	 * pub_msg descriptor from another part of the application. Note that
	 * after sending a publish message, we must free the allocated
	 * Zephyr memory pool block. */
	while ((rc = k_msgq_get(&msgq, &pub_msg, K_FOREVER)) == 0) {
		rc = mqtt_tx_publish(&pubsub_ctx.mqtt_ctx, &pub_msg.mqtt_publish_msg);
		k_mem_pool_free(&pub_msg.mem_block);
		PRINT_RESULT("mqtt_tx_publish", rc);
	}

	/* Something has failed if we get to here!!! */

	/* Disconnect */
	rc = mqtt_tx_disconnect(&pubsub_ctx.mqtt_ctx);
	PRINT_RESULT("mqtt_tx_disconnect", rc);

	k_sleep(APP_TX_RX_TIMEOUT);

	/* Close TCP connection */
	rc = mqtt_close(&pubsub_ctx.mqtt_ctx);
	PRINT_RESULT("mqtt_close", rc);

exit_pub:
	printf("\nPublisher terminated!!\n");
}

int prepare_msg(struct pub_msg *pub_msg, const char *topic, const char *payload)
{
	/* allocate a buffer (block) for the message */
	if (k_mem_pool_alloc(&pub_pool, &pub_msg->mem_block, strlen(payload), K_NO_WAIT) == 0)
	{
		/* copy the payload to the allocated buffer */
		strcpy(pub_msg->mem_block.data, payload);

		/* prepare the remainder of the message descriptor */
		pub_msg->mqtt_publish_msg.msg = pub_msg->mem_block.data;
		pub_msg->mqtt_publish_msg.msg_len = strlen(pub_msg->mqtt_publish_msg.msg);
		pub_msg->mqtt_publish_msg.qos = MQTT_QoS0;
		pub_msg->mqtt_publish_msg.topic = topic;
		pub_msg->mqtt_publish_msg.topic_len = strlen(pub_msg->mqtt_publish_msg.topic);
		pub_msg->mqtt_publish_msg.pkt_id = sys_rand32_get();

		return 0;
	} else {
		return -ENOMEM;
	}
}

void tb_publish_attributes(const char * attr_payload)
{
	struct pub_msg pub_msg;
	int rc;

	/* Prepare the pub_msg descriptor for telemetry */
	rc = prepare_msg(&pub_msg, TB_ATTRIBUTES_TOPIC, attr_payload);

	if (rc != 0) {
		PRINT_RESULT("prepare_msg", rc);
		return;
	}

	printf("tb_publish_attributes: %s\n", attr_payload);

	/* Send it to the publish message queue */
	rc = k_msgq_put(&msgq, &pub_msg, K_NO_WAIT);

	/* If we couldn't send it to the message queue, we need to free memory
	 * that was allocated for the JSON payload */

	if (rc != 0) {
		k_mem_pool_free(&pub_msg.mem_block);
		PRINT_RESULT("k_msgq_put", rc);
	}
}

void tb_publish_telemetry(const char * tlmtry_payload)
{
	struct pub_msg pub_msg;
	int rc;

	/* Prepare the pub_msg descriptor for telemetry */
	rc = prepare_msg(&pub_msg, TB_TELEMETRY_TOPIC, tlmtry_payload);

	if (rc != 0) {
		PRINT_RESULT("prepare_msg", rc);
	}

	printf("tb_publish_telemetry: %s\n", pub_msg.mqtt_publish_msg.msg);

	/* Send it to the publish message queue */
	rc = k_msgq_put(&msgq, &pub_msg, K_NO_WAIT);

	/* If we couldn't send it to the message queue, we need to free memory
	 * that was allocated for the JSON payload */
	if (rc != 0) {
		k_mem_pool_free(&pub_msg.mem_block);
		PRINT_RESULT("k_msgq_put", rc);
	}
}

void tb_pubsub_start()
{
	k_tid_t tt_tid = k_thread_create(&pubsub_thread_desc, pubsub_stack_area,
                                 K_THREAD_STACK_SIZEOF(pubsub_stack_area),
                                 pubsub_thread,
                                 NULL, NULL, NULL,
                                 PUBSUB_PRIORITY, 0, K_NO_WAIT);
}
```

## src/tb_pubsub.h
```c
#ifndef __MQTT_PUBLISHER_H__
#define __MQTT_PUBLISHER_H__

void tb_pubsub_start();
void tb_publish_attributes(const char * attr_payload);
void tb_publish_telemetry(const char * tlmtry_payload);

#endif
```

## src/valve.c
```c
#include <zephyr.h>
#include <board.h>
#include <device.h>
#include <gpio.h>
#include "valve.h" 
#include "lights.h"

#define RELAY_PORT 	"GPIO_0"
#define RELAY_PIN		31

struct device *relay_dev;

void closeValve()
{
    putLights(LED_VLV, true);
    gpio_pin_write(relay_dev, RELAY_PIN, 0);
}
void openValve()
{      
    putLights(LED_VLV, false);
    gpio_pin_write(relay_dev, RELAY_PIN, 1);
}

/*bool getValve()
{
    u32_t value;

    gpio_pin_read(led_dev, led_arr[ledno], &value);

    return value ? false : true;
}*/

void init_valve()
{
    relay_dev = device_get_binding(RELAY_PORT);
    gpio_pin_configure(relay_dev, RELAY_PIN, GPIO_DIR_OUT);
}
```

## src/valve.h
```c
#ifndef __VALVE_H__
#define __VALVE__

void closeValve();
void openValve();
//bool getValve(u32_t ledno);
void init_valve(); 

#endif
```

## src/water_flow_sensor.c
```c
#include <zephyr.h>
#include <board.h>
#include <device.h>
#include <kernel.h>
#include <misc/printk.h>
#include <gpio.h>
#include "config.h"
#include "tb_pubsub.h"
#include "lights.h"

#define WFS_PORT  "GPIO_0"
#define WFS_PIN   11

// Thresholds:
int FLUSHING_THRESHOLD = 5;
int SLOW_HIGH_THRESHOLD = 30;

#define NO_FLOW  "NO_FLOW"
#define FLUSHING_SLOW  "SLOW"
#define FLUSHING_FAST  "FAST"

#define STATES_ARRAY_SIZE  3

u8_t current_state; // numerical current state.
u8_t previous_reported_state = 4; // Previous state of the water_flow_sensor.
char *current_state_label; // Current state of the water_flow_sensor.
u32_t current_flow; // Exact flow number.

/**
  * Array used to record states during 3 consecutive detecting interval.
  * NO_FLOW is represented by 0
  * FLUSHING_SLOW is represented by 1
  * FLUSHING_FAST is be represented by 2
  */
u8_t previous_states[STATES_ARRAY_SIZE];

struct device *wfs_dev;

// Expiry function of timer.
void my_wfs_expiry_fn(struct k_work *work)
{
  u32_t cur_val = 1;
  u32_t last_val = 0;
  u32_t cnt_flow = 0;

  u32_t start_time;
  u32_t stop_time;
  u32_t cycles_spent;
  u32_t nanoseconds_spent;
  // Set the length of the detecting interval to 1.5S.
  u32_t time_interval = 1500000000;// (nanoseconds) = 1.5s.

  // Capture initial time stamp.
  start_time = k_cycle_get_32();

  printk("Detecting water flow...\n");
  while (1) {
    gpio_pin_read(wfs_dev, WFS_PIN, &cur_val);
    // Each square wave increases cur_flow by 2.
    if (cur_val != last_val) {
      cnt_flow++;
      printk("Detected\n");
    }
    last_val = cur_val;

    // Capture final time stamp.
    stop_time = k_cycle_get_32();

    // Compute how long the work took (assumes no counter rollover).
    cycles_spent = stop_time - start_time;
    nanoseconds_spent = SYS_CLOCK_HW_CYCLES_TO_NS(cycles_spent);
    //printk("Current spend time: %d.\n", nanoseconds_spent);
    // Break when spent over 2S.
    if(nanoseconds_spent >= time_interval) break;
  }
  /**
    * Water-flow Formula: 1L = 5880 square waves.
    * So 1000ml ~= 6000 square waves = 12000 cnt_flow.
    * Then 1/12 ml pre cnt_flow.
    * Flow rate: fr ~= 1/12ml/cnt_flow/1.5s = cnt_flow/18 ml/s.
    */
  current_flow = cnt_flow / 18;
  //printf("Current water flow: %d ml/s.\n", cnt_flow);
  printf("Current water flow: %d ml/s.\n", current_flow);
  update_states_array();
}

// Update the states array.
void update_states_array() {
  if (current_flow >= SLOW_HIGH_THRESHOLD) {
    current_state = 2;
    current_state_label = FLUSHING_FAST;
  } else if(current_flow >= FLUSHING_THRESHOLD){
    current_state = 1;
    current_state_label = FLUSHING_SLOW;
  } else {
    current_state = 0;
    current_state_label = NO_FLOW;
  }

  for (int i = STATES_ARRAY_SIZE - 1; i >= 0; i--) {
    previous_states[i] = previous_states[i - 1];
  }
  previous_states[0] = current_state;
  printf("previous water flow samples!\n");
  printf("[%d], [%d], [%d]\n", previous_states[0], previous_states[1], previous_states[2]);

  bool repetition = true;
  // Checking the last samples
  for (int i = 1; i < STATES_ARRAY_SIZE; i++) {
    repetition = repetition && (previous_states[i - 1] == previous_states[i]);
  }
  printf("repetition [%d] \n", repetition);

  //If NO_FLOW, turn off light
  if (current_state == 0){
    putLights(LED_WTR, false);
  }//OTHERWISE, turn on light
  else {
    putLights(LED_WTR, true);
  }
  
  // Report if there is a stable change and it is different wiht the one reported before.
  if (repetition && current_state != previous_reported_state) {
    printf("State changes!\n");
    // Update the previous state and pub the current state to Thingsboard.
    previous_reported_state = current_state;
    pub_water_data();
  }
}

// Pub the state or specific number of the water_flow_sensor.
void pub_water_data(){
  char payload[32];
  
  printf("Water flow sensor sensing event!\n");
  //snprintf(payload, sizeof(payload), "{\"flow_number\":\"%d\"}", current_flow);
  //snprintf(payload, sizeof(payload), "{\"flow_state\":\"%d\"}", current_state);
  snprintf(payload, sizeof(payload), "{\"wtr\":\"%s\", \"wtrLvl\":%d}", current_state_label, current_state);
  tb_publish_telemetry(payload);
}

K_WORK_DEFINE(tic_water_sensor, my_wfs_expiry_fn);

/*
void my_timer_handler(struct k_timer *dummy)
{
  k_work_submit(&tic_water_sensor);
}

K_TIMER_DEFINE(my_timer, my_timer_handler, NULL);
*/

void init_water_flow_sensor()
{
  // Configure water flow sensor GPIO.
  wfs_dev = device_get_binding(WFS_PORT);
  gpio_pin_configure(wfs_dev, WFS_PIN, GPIO_DIR_IN | GPIO_PUD_PULL_UP);

  printk("Water Flow Sensor is Configured\n");
  // Submit detecting work every 3 seconds after a second.
  //Moving timer to sensors
  //k_timer_start(&my_timer, K_SECONDS(1), K_SECONDS(3));
}
```

## src/water_flow_sensor.h
```c
#ifndef __WATER_FLOW_SENSOR_H__
#define __WATER_FLOW_SENSOR_H__

struct k_work tic_water_sensor;
void init_water_flow_sensor();

#endif
```
